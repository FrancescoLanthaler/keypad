#include <SPI.h>
#include <Wire.h>
#include <Adafruit_GFX.h>
#include <Adafruit_SSD1306.h>

#include <Bounce2.h>
#include <HID-Project.h>
#include <HID-Settings.h>



// ---------------------------------
#define CLK 4
#define DT 5
#define SW 6

#define SCREEN_WIDTH 128 // OLED display width, in pixels
#define SCREEN_HEIGHT 32 // OLED display height, in pixels
#define OLED_RESET -1  // GPIO0
Adafruit_SSD1306 display(SCREEN_WIDTH, SCREEN_HEIGHT, &Wire, OLED_RESET);

const unsigned char PROGMEM frame0 [] = {0x00, 0x00, 0x00, 0x00, 0x00, 0x06, 0x00, 0x0F, 0x00, 0x00, 0x00, 0x00, 0x00,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 0x00, 0x00};

const unsigned char PROGMEM frame1 [] = {0x00, 0x00, 0x00, 0x00, 0x00, 0x06, 0x00, 0x0F, 0x00, 0x00, 0x00, 0x00, 0x00,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 0x00, 0x00};

const unsigned char PROGMEM frame2 [] = {0x00, 0x00, 0x00, 0x00, 0x00, 0x06, 0x00, 0x0F, 0x00, 0x00, 0x00, 0x00, 0x00,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 0x00, 0x00};


// Key definitions
#define BUTTON_KEY1 MEDIA_PLAY_PAUSE
#define BUTTON_KEY2 MEDIA_PLAY_PAUSE
#define BUTTON_KEY3 MEDIA_PLAY_PAUSE
#define BUTTON_KEY4 MEDIA_PLAY_PAUSE
#define BUTTON_KEY5 MEDIA_PLAY_PAUSE
#define BUTTON_KEY6 MEDIA_PLAY_PAUSE
#define BUTTON_KEY7 MEDIA_PLAY_PAUSE
#define BUTTON_KEY8 MEDIA_PLAY_PAUSE
#define BUTTON_KEY9 MEDIA_PLAY_PAUSE
#define BUTTON_KEY10 MEDIA_PLAY_PAUSE
#define BUTTON_KEY11 MEDIA_PLAY_PAUSE
#define BUTTON_KEY12 MEDIA_PLAY_PAUSE

// Pin definitions
#define BUTTON_PIN1 0
#define BUTTON_PIN2 9
#define BUTTON_PIN3 16
#define BUTTON_PIN4 14
#define BUTTON_PIN5 1
#define BUTTON_PIN6 7  
#define BUTTON_PIN7 15
#define BUTTON_PIN8 18
#define BUTTON_PIN9 8
#define BUTTON_PIN10 10
#define BUTTON_PIN11 20
#define BUTTON_PIN12 19
//#define BUTTON_PIN13 18                   ***         Taster nutzen
//#define BUTTON_PIN14 19
//#define BUTTON_PIN15 20

Bounce ClickDebounce = Bounce();
Bounce VolumeDebounce = Bounce();
Bounce DirDebounce = Bounce();

int counter = 0;
int currentStateCLK;
int lastStateCLK;
int clickState;
String currentDir ="";
int lastClick;

int xx=0;
int yy=0;
int tt=0;

// ---------------------------------

//#include "Keyboard.h"

// Button helper class for handling press/release and debouncing
class button {
  public:
  const uint8_t key;
  const uint8_t pin;

  button(uint8_t k, uint8_t p) : key(k), pin(p){}

  void press(boolean state){
    if(state == pressed || (millis() - lastPressed  <= debounceTime)){
      return; // Nothing to see here, folks
    }

    lastPressed = millis();

   //state ? Keyboard.press(key) : Keyboard.release(key); 
   if(state)
    Consumer.write(key);
    pressed = state;
  }

  void update(){
    press(!digitalRead(pin));
  }
                      
  private:
  const unsigned long debounceTime = 30;
  unsigned long lastPressed = 0;
  boolean pressed = 0;
} ;

// Button objects, organized in array
button buttons[] = {
  {BUTTON_KEY1, BUTTON_PIN1},
  {BUTTON_KEY2, BUTTON_PIN2},
  {BUTTON_KEY3, BUTTON_PIN3},
  {BUTTON_KEY4, BUTTON_PIN4},
  {BUTTON_KEY5, BUTTON_PIN5},
  {BUTTON_KEY6, BUTTON_PIN6},
  {BUTTON_KEY7, BUTTON_PIN7},
  {BUTTON_KEY8, BUTTON_PIN8},
  {BUTTON_KEY9, BUTTON_PIN9},
  {BUTTON_KEY10, BUTTON_PIN10},
  {BUTTON_KEY11, BUTTON_PIN11},
  {BUTTON_KEY12, BUTTON_PIN12},
  //{BUTTON_KEY13, BUTTON_PIN13},               ***   Taster mit PINS
  //{BUTTON_KEY14, BUTTON_PIN14},
  //{BUTTON_KEY15, BUTTON_PIN15},
  
};

const uint8_t NumButtons = sizeof(buttons) / sizeof(button);
const uint8_t ledPin = 17;

void displayAnimation1();

void setup() { 
  Consumer.begin();
  // Safety check. Ground pin #1 (RX) to cancel keyboard inputs.
  pinMode(1, INPUT_PULLUP);
  if(!digitalRead(1)){
    failsafe();
  }


  //Display
  if(!display.begin(SSD1306_SWITCHCAPVCC, 0x3C)) { 
    Serial.println(F("SSD1306 allocation failed"));
   for(;;); // Don't proceed, loop forever
  }
  display.display();
  delay(2000); // Pause for 2 seconds

  display.clearDisplay();
  display.drawPixel(10, 10, WHITE);
          
  display.display();
  delay(2000);  
  //Display End
   
  for(int i = 0; i < NumButtons; i++){
    pinMode(buttons[i].pin, INPUT_PULLUP);
  }
  
  // Set encoder pins as inputs
  pinMode(CLK,INPUT);
  pinMode(DT,INPUT);
  pinMode(SW, INPUT_PULLUP);

  // Setup Serial Monitor
  Serial.begin(9600);

  //Keyboard Library
  Consumer.begin();

  //Debounce
  ClickDebounce.attach(SW, INPUT_PULLUP);
  ClickDebounce.interval(25);
  VolumeDebounce.attach(CLK, INPUT);
  VolumeDebounce.interval(5);
  DirDebounce.attach(DT, INPUT);
  DirDebounce.interval(5);
  
  // Read the initial state of CLK
  lastStateCLK = digitalRead(CLK);
}

void loop() {
  for(int i = 0; i < NumButtons; i++){
    buttons[i].update();
  }
   ClickDebounce.update();
  VolumeDebounce.update();
  DirDebounce.update();
  
  
  // Read the current state of CLK
  currentStateCLK = VolumeDebounce.read();
  clickState = ClickDebounce.read();
  
  if (clickState == LOW && lastClick == HIGH)
      Consumer.write(MEDIA_PLAY_PAUSE);
      
  // If last and current state of CLK are different, then pulse occurred
  // React to only 1 state change to avoid double count
  
  if (currentStateCLK != lastStateCLK  && currentStateCLK == 1){
    if (DirDebounce.read() != currentStateCLK) { // If the DT state is different than the CLK state then the encoder is rotating CCW so decrement
      Consumer.write(MEDIA_VOL_DOWN);   
    } 
    else {
      Consumer.write(MEDIA_VOL_UP);
    }
  }

  // Remember last CLK state
  lastStateCLK = currentStateCLK;
  lastClick = clickState;
  displayAnimation1();
}

void displayAnimation1(){
  display.clearDisplay();
  display.drawBitmap(xx, yy,frame0,128,32, 1);
  display.display();
  delay(tt);

  display.clearDisplay();
  display.drawBitmap(xx, yy,frame1,128,32, 1);
  display.display();
  delay(tt);

  display.clearDisplay();
  display.drawBitmap(xx, yy,frame2,128,32, 1);
  display.display();
  delay(tt);
  }

void failsafe(){
  for(;;){} // Just going to hang out here for awhile :D
}
